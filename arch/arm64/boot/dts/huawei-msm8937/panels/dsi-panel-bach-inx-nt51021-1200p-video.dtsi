&mdss_mdp {
	dsi_bach_inx_nt51021_1200p_video: qcom,mdss_dsi_bach_inx_nt51021_1200p_video {
		qcom,mdss-dsi-panel-name = "INX_NT51021 10P1 VIDEO TFT 1200 x 1920";
		qcom,mdss-dsi-panel-controller = <&mdss_dsi0>;
		qcom,mdss-dsi-panel-type = "dsi_video_mode";
		qcom,mdss-dsi-panel-destination = "display_1";
		qcom,mdss-dsi-panel-framerate = <60>;
		qcom,mdss-dsi-virtual-channel-id = <0>;
		qcom,mdss-dsi-stream = <0>;
		qcom,mdss-dsi-panel-width = <1200>;
		qcom,mdss-dsi-panel-height = <1920>;
		qcom,mdss-dsi-h-front-porch = <168>;
		qcom,mdss-dsi-h-back-porch = <32>;
		qcom,mdss-dsi-h-pulse-width = <2>;
		qcom,mdss-dsi-h-sync-skew = <0>;
		qcom,mdss-dsi-v-back-porch = <14>;
		qcom,mdss-dsi-v-front-porch = <25>;
		qcom,mdss-dsi-v-pulse-width = <2>;
		qcom,mdss-dsi-h-left-border = <0>;
		qcom,mdss-dsi-h-right-border = <0>;
		qcom,mdss-dsi-v-top-border = <0>;
		qcom,mdss-dsi-v-bottom-border = <0>;
		qcom,mdss-dsi-bpp = <24>;
		qcom,mdss-dsi-underflow-color = <0x00>;
		qcom,mdss-dsi-border-color = <0>;
		qcom,mdss-dsi-on-command = [
			15 01 00 00 14 00 02 01 00
			15 01 00 00 00 00 02 8c 80
			15 01 00 00 00 00 02 c7 50
			15 01 00 00 00 00 02 c5 50
			15 01 00 00 00 00 02 85 04
			15 01 00 00 00 00 02 86 08
			15 01 00 00 00 00 02 83 00
			15 01 00 00 00 00 02 84 00
			15 01 00 00 00 00 02 a9 0a
			15 01 00 00 00 00 02 83 bb
			15 01 00 00 00 00 02 84 22
			15 01 00 00 00 00 02 90 00
			15 01 00 00 00 00 02 a1 ff
			15 01 00 00 00 00 02 a2 fc
			15 01 00 00 00 00 02 a3 f7
			15 01 00 00 00 00 02 a4 f3
			15 01 00 00 00 00 02 a5 e9
			15 01 00 00 00 00 02 a6 e2
			15 01 00 00 00 00 02 a7 dc
			15 01 00 00 00 00 02 a8 d7
			15 01 00 00 00 00 02 a9 d1
			15 01 00 00 00 00 02 aa cc
			15 01 00 00 00 00 02 b4 42
			15 01 00 00 00 00 02 b5 5b
			15 01 00 00 00 00 02 b6 51
			15 01 00 00 00 00 02 ad 03
			15 01 00 00 00 00 02 9a 10
			15 01 00 00 00 00 02 94 b8
			15 01 00 00 00 00 02 95 00
			15 01 00 00 00 00 02 99 00
			15 01 00 00 00 00 02 96 00
			15 01 00 00 00 00 02 83 aa
			15 01 00 00 00 00 02 84 11
			15 01 00 00 00 00 02 9c 10
			15 01 00 00 64 00 02 a9 4b
		];
		qcom,mdss-dsi-on-command-state = "dsi_lp_mode";
		qcom,mdss-dsi-off-command = [
			15 01 00 00 64 00 02 10 00
		];
		qcom,mdss-dsi-off-command-state = "dsi_lp_mode";
		qcom,mdss-dsi-bllp-eof-power-mode;
		qcom,mdss-dsi-bllp-power-mode;
		qcom,mdss-dsi-traffic-mode = "burst_mode";
		qcom,mdss-dsi-te-dcs-command = <1>;
		qcom,mdss-dsi-te-pin-select = <1>;
		qcom,mdss-dsi-color-order = "rgb_swap_rgb";
		qcom,mdss-dsi-lane-0-state;
		qcom,mdss-dsi-lane-1-state;
		qcom,mdss-dsi-lane-2-state;
		qcom,mdss-dsi-lane-3-state;
		qcom,mdss-dsi-panel-clockrate = <989760000>;
		qcom,mdss-dsi-panel-timings = [5d 42 2a 01 70 7a 2e 42 4a 03 04 00];
		qcom,mdss-dsi-t-clk-pre = <0x1b>;
		qcom,mdss-dsi-t-clk-post = <0x04>;
		qcom,mdss-dsi-tx-eot-append;
		qcom,mdss-dsi-mdp-trigger = "none";
		qcom,mdss-dsi-dma-trigger = "trigger_sw";
		qcom,mdss-dsi-force-clock-lane-hs;
		qcom,mdss-dsi-bl-pmic-control-type = "bl_ctrl_dcs";
		qcom,mdss-dsi-bl-min-level = <1>;
		qcom,mdss-dsi-bl-max-level = <255>;
		qcom,panel-supply-entries = <&dsi_panel_pwr_supply>;
		qcom,mdss-dsi-lane-map = "lane_map_0123";
		qcom,mdss-dsi-lp11-init;
	};
};
