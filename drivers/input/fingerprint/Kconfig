## drivers/input/fingerprint/Kconfig
```kconfig
menu "Fingerprint Drivers"

source "drivers/input/fingerprint/fpc_ugg/Kconfig"
source "drivers/input/fingerprint/gf3208_ugg/Kconfig"

source "drivers/input/fingerprint/fpc_landtoni/Kconfig"
source "drivers/input/fingerprint/goodix_landtoni/Kconfig"

endmenu

config FINGERPRINT_HUAWEI_BACH
	tristate "Huawei BAH fingerprint sensor driver"
	depends on SPI
	help
	  Huawei BAH fingerprint sensor driver (3.18 port).
	  Creates /dev/fingerprint for FPC HAL.
```
